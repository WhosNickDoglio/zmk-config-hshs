## config/west.yml
```yaml
manifest:
  remotes:
    - name: zmkfirmware
      url-base: https://github.com/zmkfirmware
    - name: perrwa
      url-base: https://github.com/perrwa
  projects:
    - name: zmk
      remote: zmkfirmware
      revision: v0.4.0
      import: app/west.yml
    - name: zmk-component-raytac-dongle
      remote: perrwa
      revision: main
  self:
    path: config
```
